/*
 * Copyright (c) 2021 The ZMK Contributors
 *
 * SPDX-License-Identifier: MIT
 */

/dts-v1/;
#include "zm_ble.dtsi"

/ {
    chosen {
        zmk,battery = &vbatt;
    };

    // Node name must match original "EXT_POWER" label to preserve user settings.
    // EXT_POWER {
    //     compatible = "zmk,ext-power-generic";
    //     control-gpios = <&gpio0 13 GPIO_ACTIVE_LOW>;
    // };

    vbatt: vbatt {
        compatible = "zmk,battery-voltage-divider";
        // Dev Board R1 pin = AIN7
        io-channels = <&adc 2>; // AINx on the nRF Schematic
        output-ohms = <1000000>; // Bottom Resistor in the voltage divider
        full-ohms = <(400000 + 1000000)>; // Bot + Top Resistor in the voltage divider
    };
};
